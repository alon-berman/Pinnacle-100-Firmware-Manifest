## west.yml
```yaml
manifest:
  remotes:
    - name: JsmnRepo
      url-base: https://github.com/zserge
    - name: LairdCP
      url-base: https://github.com/LairdCP

  # Please add items below based on alphabetical order.
  # These dependencies may need updating if new features are added to the firmware.
  projects:
    - name: attributes
      path: modules/lib/laird_connect/attributes
      revision: d483d230e02266d43e369adc75afc1044ee5c06f
      remote: LairdCP
    - name: zephyr_framework
      path: modules/lib/laird_connect/framework
      revision: 83f6016390290b30c93bb55b854051bbcde532b9
      remote: LairdCP
    - name: jsmn
      path: modules/lib/jsmn
      revision: 053d3cd29200edb1bfd181d917d140c16c1f8834
      remote: JsmnRepo
    - name: BLE_Gateway_Firmware
      path: ble_gateway_firmware
      revision: bffe87dea0c587e2c30fe90388b889ca5bda283b
      remote: LairdCP
    - name: memfault-firmware-sdk
      path: modules/lib/memfault-firmware-sdk
      revision: 0.31.2
      remote: LairdCP
    - name: sdk-nrf
      path: nrf
      revision: v1.7.0
      remote: LairdCP
      import: true
    - name: zephyr
      revision: fec5a93676aaccdb15412b1ca197e26fbdf5ce0f
      remote: LairdCP
      import:
        # In addition to the zephyr repository itself, NCS also
        # imports the contents of zephyr/west.yml.
        # Only the projects explicitly named in the
        # following whitelist are imported.
        #
        # Note that the zephyr west extensions (like 'build', 'flash',
        # 'debug', etc.) are automatically provided by this import, so
        # there's no need to add a redundant west-commands: key for
        # the zephyr project.
        #
        # Please keep this list sorted alphabetically.
        name-whitelist:
          - cmsis
          - fatfs
          - hal_nordic
          - libmetal
          - littlefs
          - lvgl
          - mbedtls
          - mcumgr
          - mipi-sys-t
          - net-tools
          - nrf_hw_models
          - open-amp
          - openthread
          - segger
          - tinycbor
          - tinycrypt
    - name: zephyr_boards
      path: boards/arm
      revision: e529f3c110dd661f1d10f84ad325a7c0238411c9
      remote: LairdCP
    - name: zephyr_lib
      path: modules/lib/laird_connect/zephyr_lib
      revision: 0d1223f89775436782558334a11ab839527e752b
      remote: LairdCP

  self:
    path: pinnacle_100_firmware_public_manifest
```
